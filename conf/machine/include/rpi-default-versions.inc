## conf/machine/include/rpi-default-versions.inc
```bitbake
# RaspberryPi BSP default versions

PREFERRED_VERSION_linux-raspberrypi ??= "6.10.%"
PREFERRED_VERSION_linux-raspberrypi-v7 ??= "${PREFERRED_VERSION_linux-raspberrypi}"
```
